/ {
    led_strip: ws2812@0 {
        compatible = "worldsemi,ws2812-spi";
        label = "LED";
        spi-max-frequency = <8000000>;
        reg = <0>;
        color-order = <RGB>;
        chain-length = <58>;
        status = "okay";
    };
};

&spi1 {
    status = "okay";
    cs-gpios = <&gpio0 17 GPIO_ACTIVE_LOW>;  // Update pin to match your wiring
};
